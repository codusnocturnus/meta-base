## conf/layer.conf
```bitbake
# Put this layer directory at the head of the layer directory path.
BBPATH .= ":${LAYERDIR}"

# Put this layer's recipe pattern at the head of the recipe pattern list.
BBFILES += "${LAYERDIR}/recipes-*/*/*.bb \
            ${LAYERDIR}/recipes-*/*/*.bbappend \
           "

# Add this layer's name to end of the list of layer names.
BBFILE_COLLECTIONS += "base"

# Set the priority for this layer.
BBFILE_PRIORITY_base = "1"

# Set the directory pattern for this layer. This *appears* to enable BitBake to
# pick out the patterns in BBFILES that apply to this layer. This *seems* to be
# fundamental to enforcing the priority order.
BBFILE_PATTERN_base := "^${LAYERDIR}/"
LAYERVERSION_base = "1"

LAYERSERIES_CORENAMES = "base"
LAYERSERIES_COMPAT_base = "base"
```
